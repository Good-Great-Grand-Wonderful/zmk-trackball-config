## Kconfig
```kconfig
DT_COMPAT_GGGW_TRACKBALL_CONFIG := gggw,trackball-config

config ZMK_TRACKBALL_CONFIG
	bool "Host-facing USB serial service to configure trackball mode and CPI"
	default $(dt_compat_enabled,$(DT_COMPAT_GGGW_TRACKBALL_CONFIG))
	depends on SERIAL
	depends on ZMK_INPUT_PROCESSOR_PIPELINE_SWITCH
	depends on ZMK_BEHAVIOR_PIPELINE_SWITCH
	depends on ZMK_BEHAVIOR_PAW32XX_RES_SET
	imply SETTINGS
	help
	  Exposes a config protocol over a USB CDC-ACM serial port on the central
	  half (the chosen gggw,trackball-config-uart node) so a host app can read
	  each trackball's available modes + CPI range (Describe), read the current
	  selection (State), and change them (Control). The central is the sole
	  originator: it relays changes to the left (peripheral) ball and keeps an
	  authoritative, persisted mirror.
```

## dts/bindings/gggw,trackball-config.yaml
```yaml
# Copyright (c) 2026 Vincent Franco
# SPDX-License-Identifier: MIT

description: |
  Central-side BLE service that lets a host app configure both trackballs'
  Mode (pipeline) and CPI. References, per side, the pipeline-switch processor
  (for mode introspection), the pipeline-switch behavior (invoke target), and
  the res-set behavior (CPI introspection + invoke target).

compatible: "gggw,trackball-config"

properties:
  left-pipeline:
    required: true
    type: phandle
    description: Left ball's zmk,input-processor-pipeline-switch (mode introspection).
  right-pipeline:
    required: true
    type: phandle
    description: Right ball's zmk,input-processor-pipeline-switch (mode introspection).
  left-mode-behavior:
    required: true
    type: phandle
    description: Left ball's zmk,behavior-pipeline-switch (mode invoke target; relayed).
  right-mode-behavior:
    required: true
    type: phandle
    description: Right ball's zmk,behavior-pipeline-switch (mode invoke target; local).
  left-cpi:
    required: true
    type: phandle
    description: Left ball's zmk,behavior-paw32xx-res-set (CPI introspection + invoke; relayed).
  right-cpi:
    required: true
    type: phandle
    description: Right ball's zmk,behavior-paw32xx-res-set (CPI introspection + invoke; local).
  left-peripheral-source:
    type: int
    default: 0
    description: Split source index of the left (peripheral) half for relayed invocations.
```
